/**
 * @cliArgs --board "/ti/boards/LP_MSPM0G3507" --product "mspm0_sdk@2.05.01.00"
 * @versions {"tool":"1.24.1+4189"}
 */
scripting.excludeFromBuild("device_linker.lds");

/**
 * Import the modules used in this configuration.
 */
const Board         = scripting.addModule("/ti/driverlib/Board");
const GPIO          = scripting.addModule("/ti/driverlib/GPIO", {}, false);
const GPIO1         = GPIO.addInstance();
const GPIO2         = GPIO.addInstance();
const GPIO3         = GPIO.addInstance();
const GPIO4         = GPIO.addInstance();
const I2C           = scripting.addModule("/ti/driverlib/I2C", {}, false);
const I2C1          = I2C.addInstance();
const MATHACL       = scripting.addModule("/ti/driverlib/MATHACL");
const PWM           = scripting.addModule("/ti/driverlib/PWM", {}, false);
const PWM1          = PWM.addInstance();
const SYSCTL        = scripting.addModule("/ti/driverlib/SYSCTL");
const SYSTICK       = scripting.addModule("/ti/driverlib/SYSTICK");
const TIMER         = scripting.addModule("/ti/driverlib/TIMER", {}, false);
const TIMER1        = TIMER.addInstance();
const UART          = scripting.addModule("/ti/driverlib/UART", {}, false);
const UART1         = UART.addInstance();
const UART2         = UART.addInstance();
const ProjectConfig = scripting.addModule("/ti/project_config/ProjectConfig");

/**
 * Write custom configuration values to the imported modules.
 */
const divider9       = system.clockTree["UDIV"];
divider9.divideValue = 2;

const gate7  = system.clockTree["MFCLKGATE"];
gate7.enable = true;

const gate8  = system.clockTree["MFPCLKGATE"];
gate8.enable = true;

const multiplier2         = system.clockTree["PLL_QDIV"];
multiplier2.multiplyValue = 4;

const mux4       = system.clockTree["EXHFMUX"];
mux4.inputSelect = "EXHFMUX_XTAL";

const mux8       = system.clockTree["HSCLKMUX"];
mux8.inputSelect = "HSCLKMUX_SYSPLL0";

const mux12       = system.clockTree["SYSPLLMUX"];
mux12.inputSelect = "zSYSPLLMUX_HFCLK";

const pinFunction4                        = system.clockTree["HFXT"];
pinFunction4.enable                       = true;
pinFunction4.inputFreq                    = 40;
pinFunction4.peripheral.$assign           = "SYSCTL";
pinFunction4.peripheral.hfxInPin.$assign  = "j17_expansion.4";
pinFunction4.peripheral.hfxOutPin.$assign = "j17_expansion.5";

Board.peripheral.$assign          = "DEBUGSS";
Board.peripheral.swclkPin.$assign = "j25_expansion.16";
Board.peripheral.swdioPin.$assign = "j25_expansion.14";

GPIO1.$name                          = "PORTA";
GPIO1.port                           = "PORTA";
GPIO1.associatedPins.create(4);
GPIO1.associatedPins[0].$name        = "USER_LED";
GPIO1.associatedPins[0].assignedPin  = "0";
GPIO1.associatedPins[0].initialValue = "SET";
GPIO1.associatedPins[0].ioStructure  = "OD";
GPIO1.associatedPins[0].pin.$assign  = "j19_expansion.9";
GPIO1.associatedPins[1].$name        = "MOTOR_STDBY";
GPIO1.associatedPins[1].assignedPin  = "27";
GPIO1.associatedPins[2].assignedPin  = "24";
GPIO1.associatedPins[2].ioStructure  = "SD";
GPIO1.associatedPins[2].$name        = "MOTOR_B1";
GPIO1.associatedPins[3].ioStructure  = "SD";
GPIO1.associatedPins[3].$name        = "MOTOR_B2";
GPIO1.associatedPins[3].assignedPin  = "15";

GPIO2.$name                               = "PORTB";
GPIO2.port                                = "PORTB";
GPIO2.associatedPins.create(7);
GPIO2.associatedPins[0].direction         = "INPUT";
GPIO2.associatedPins[0].ioStructure       = "SD";
GPIO2.associatedPins[0].interruptEn       = true;
GPIO2.associatedPins[0].polarity          = "RISE";
GPIO2.associatedPins[0].$name             = "ENCODER1_A";
GPIO2.associatedPins[0].interruptPriority = "0";
GPIO2.associatedPins[0].pin.$assign       = "boosterpack.39";
GPIO2.associatedPins[1].direction         = "INPUT";
GPIO2.associatedPins[1].ioStructure       = "SD";
GPIO2.associatedPins[1].$name             = "ENCODER1_B";
GPIO2.associatedPins[1].pin.$assign       = "boosterpack.40";
GPIO2.associatedPins[2].$name             = "ENCODER2_A";
GPIO2.associatedPins[2].direction         = "INPUT";
GPIO2.associatedPins[2].ioStructure       = "SD";
GPIO2.associatedPins[2].interruptEn       = true;
GPIO2.associatedPins[2].polarity          = "RISE";
GPIO2.associatedPins[2].interruptPriority = "0";
GPIO2.associatedPins[2].assignedPin       = "12";
GPIO2.associatedPins[3].$name             = "ENCODER2_B";
GPIO2.associatedPins[3].direction         = "INPUT";
GPIO2.associatedPins[3].ioStructure       = "SD";
GPIO2.associatedPins[3].assignedPin       = "17";
GPIO2.associatedPins[4].ioStructure       = "SD";
GPIO2.associatedPins[4].assignedPin       = "24";
GPIO2.associatedPins[4].$name             = "MOTOR_A1";
GPIO2.associatedPins[4].pin.$assign       = "boosterpack.6";
GPIO2.associatedPins[5].$name             = "MOTOR_A2";
GPIO2.associatedPins[5].ioStructure       = "SD";
GPIO2.associatedPins[5].assignedPin       = "9";
GPIO2.associatedPins[6].launchPadShortcut = "Button3En";
GPIO2.associatedPins[6].ioStructure       = "SD";
GPIO2.associatedPins[6].$name             = "BUTTON_S2";
GPIO2.associatedPins[6].interruptEn       = true;
GPIO2.associatedPins[6].interruptPriority = "0";
GPIO2.associatedPins[6].polarity          = "FALL";
GPIO2.associatedPins[6].pin.$assign       = "j19_expansion.4";

GPIO3.port                          = "PORTB";
GPIO3.$name                         = "SENSOR_PORTB";
GPIO3.associatedPins.create(6);
GPIO3.associatedPins[0].assignedPin = "10";
GPIO3.associatedPins[0].direction   = "INPUT";
GPIO3.associatedPins[0].$name       = "SENSOR_IN1";
GPIO3.associatedPins[0].ioStructure = "SD";
GPIO3.associatedPins[0].pin.$assign = "j19_expansion.2";
GPIO3.associatedPins[1].$name       = "SENSOR_IN2";
GPIO3.associatedPins[1].direction   = "INPUT";
GPIO3.associatedPins[1].ioStructure = "SD";
GPIO3.associatedPins[1].assignedPin = "11";
GPIO3.associatedPins[2].$name       = "SENSOR_IN4";
GPIO3.associatedPins[2].direction   = "INPUT";
GPIO3.associatedPins[2].ioStructure = "SD";
GPIO3.associatedPins[2].assignedPin = "22";
GPIO3.associatedPins[3].$name       = "SENSOR_IN5";
GPIO3.associatedPins[3].direction   = "INPUT";
GPIO3.associatedPins[3].assignedPin = "23";
GPIO3.associatedPins[3].ioStructure = "SD";
GPIO3.associatedPins[4].$name       = "SENSOR_IN6";
GPIO3.associatedPins[4].direction   = "INPUT";
GPIO3.associatedPins[4].ioStructure = "SD";
GPIO3.associatedPins[4].assignedPin = "25";
GPIO3.associatedPins[5].$name       = "SENSOR_IN7";
GPIO3.associatedPins[5].assignedPin = "26";
GPIO3.associatedPins[5].direction   = "INPUT";
GPIO3.associatedPins[5].ioStructure = "SD";

GPIO4.$name                         = "SENSOR_PORTA";
GPIO4.port                          = "PORTA";
GPIO4.associatedPins[0].$name       = "SENSOR_IN3";
GPIO4.associatedPins[0].direction   = "INPUT";
GPIO4.associatedPins[0].ioStructure = "SD";
GPIO4.associatedPins[0].assignedPin = "7";
GPIO4.associatedPins[0].pin.$assign = "j17_expansion.6";

I2C1.$name                             = "I2C0";
I2C1.peripheral.$assign                = "I2C0";
I2C1.peripheral.sdaPin.$assign         = "boosterpack.38";
I2C1.peripheral.sclPin.$assign         = "boosterpack.37";
I2C1.sdaPinConfig.hideOutputInversion  = scripting.forceWrite(false);
I2C1.sdaPinConfig.onlyInternalResistor = scripting.forceWrite(false);
I2C1.sdaPinConfig.passedPeripheralType = scripting.forceWrite("Digital");
I2C1.sdaPinConfig.$name                = "ti_driverlib_gpio_GPIOPinGeneric6";
I2C1.sclPinConfig.hideOutputInversion  = scripting.forceWrite(false);
I2C1.sclPinConfig.onlyInternalResistor = scripting.forceWrite(false);
I2C1.sclPinConfig.passedPeripheralType = scripting.forceWrite("Digital");
I2C1.sclPinConfig.$name                = "ti_driverlib_gpio_GPIOPinGeneric7";

PWM1.$name                              = "MOTOR_TIM";
PWM1.dutyArgs                           = "[50,0,0,0]";
PWM1.clockPrescale                      = 8;
PWM1.timerStartTimer                    = true;
PWM1.pwmMode                            = "EDGE_ALIGN_UP";
PWM1.peripheral.ccp0Pin.$assign         = "boosterpack.4";
PWM1.peripheral.ccp1Pin.$assign         = "boosterpack.24";
PWM1.PWM_CHANNEL_0.$name                = "ti_driverlib_pwm_PWMTimerCC0";
PWM1.PWM_CHANNEL_0.ccValue              = 0;
PWM1.PWM_CHANNEL_0.dutyCycle            = 0;
PWM1.PWM_CHANNEL_1.$name                = "ti_driverlib_pwm_PWMTimerCC1";
PWM1.ccp0PinConfig.$name                = "ti_driverlib_gpio_GPIOPinGeneric2";
PWM1.ccp0PinConfig.direction            = scripting.forceWrite("OUTPUT");
PWM1.ccp0PinConfig.hideOutputInversion  = scripting.forceWrite(false);
PWM1.ccp0PinConfig.onlyInternalResistor = scripting.forceWrite(false);
PWM1.ccp0PinConfig.passedPeripheralType = scripting.forceWrite("Digital");
PWM1.ccp1PinConfig.$name                = "ti_driverlib_gpio_GPIOPinGeneric3";
PWM1.ccp1PinConfig.direction            = scripting.forceWrite("OUTPUT");
PWM1.ccp1PinConfig.hideOutputInversion  = scripting.forceWrite(false);
PWM1.ccp1PinConfig.onlyInternalResistor = scripting.forceWrite(false);
PWM1.ccp1PinConfig.passedPeripheralType = scripting.forceWrite("Digital");

SYSCTL.clockTreeEn = true;
scripting.suppress("For best practices when the CPUCLK is running at 32MHz and above, clear the flash status bit using DL_FlashCTL_executeClearStatus\\(\\) before executing any flash operation\\. Otherwise there may be false positives\\.", SYSCTL);

SYSTICK.periodEnable      = true;
SYSTICK.interruptEnable   = true;
SYSTICK.systickEnable     = true;
SYSTICK.period            = 80000;
SYSTICK.interruptPriority = "1";

TIMER1.timerMode          = "PERIODIC";
TIMER1.interrupts         = ["ZERO"];
TIMER1.timerPeriod        = "10 ms";
TIMER1.interruptPriority  = "0";
TIMER1.$name              = "CONTROL_TIM";
TIMER1.timerClkDiv        = 4;
TIMER1.peripheral.$assign = "TIMG12";

UART1.enableDMARX                      = false;
UART1.enableDMATX                      = false;
UART1.$name                            = "UART0";
UART1.enableFIFO                       = true;
UART1.targetBaudRate                   = 115200;
UART1.peripheral.$assign               = "UART0";
UART1.peripheral.rxPin.$assign         = "boosterpack.33";
UART1.peripheral.txPin.$assign         = "boosterpack.34";
UART1.txPinConfig.direction            = scripting.forceWrite("OUTPUT");
UART1.txPinConfig.hideOutputInversion  = scripting.forceWrite(false);
UART1.txPinConfig.onlyInternalResistor = scripting.forceWrite(false);
UART1.txPinConfig.passedPeripheralType = scripting.forceWrite("Digital");
UART1.txPinConfig.$name                = "ti_driverlib_gpio_GPIOPinGeneric0";
UART1.rxPinConfig.hideOutputInversion  = scripting.forceWrite(false);
UART1.rxPinConfig.onlyInternalResistor = scripting.forceWrite(false);
UART1.rxPinConfig.passedPeripheralType = scripting.forceWrite("Digital");
UART1.rxPinConfig.$name                = "ti_driverlib_gpio_GPIOPinGeneric1";

UART2.$name                            = "UART1";
UART2.peripheral.$assign               = "UART1";
UART2.peripheral.rxPin.$assign         = "boosterpack.14";
UART2.peripheral.txPin.$assign         = "boosterpack.13";
UART2.txPinConfig.direction            = scripting.forceWrite("OUTPUT");
UART2.txPinConfig.hideOutputInversion  = scripting.forceWrite(false);
UART2.txPinConfig.onlyInternalResistor = scripting.forceWrite(false);
UART2.txPinConfig.passedPeripheralType = scripting.forceWrite("Digital");
UART2.txPinConfig.$name                = "ti_driverlib_gpio_GPIOPinGeneric4";
UART2.rxPinConfig.hideOutputInversion  = scripting.forceWrite(false);
UART2.rxPinConfig.onlyInternalResistor = scripting.forceWrite(false);
UART2.rxPinConfig.passedPeripheralType = scripting.forceWrite("Digital");
UART2.rxPinConfig.$name                = "ti_driverlib_gpio_GPIOPinGeneric5";

ProjectConfig.genLibIQ           = true;
ProjectConfig.genLibIQVersion    = "MATHACL";
ProjectConfig.migrationCondition = true;

/**
 * Pinmux solution for unlocked pins/peripherals. This ensures that minor changes to the automatic solver in a future
 * version of the tool will not impact the pinmux you originally saw.  These lines can be completely deleted in order to
 * re-solve from scratch.
 */
GPIO1.associatedPins[1].pin.$suggestSolution = "boosterpack.8";
GPIO1.associatedPins[2].pin.$suggestSolution = "boosterpack.27";
GPIO1.associatedPins[3].pin.$suggestSolution = "boosterpack.30";
GPIO2.associatedPins[2].pin.$suggestSolution = "boosterpack.19";
GPIO2.associatedPins[3].pin.$suggestSolution = "boosterpack.18";
GPIO2.associatedPins[5].pin.$suggestSolution = "boosterpack.7";
GPIO3.associatedPins[1].pin.$suggestSolution = "j19_expansion.3";
GPIO3.associatedPins[2].pin.$suggestSolution = "j19_expansion.5";
GPIO3.associatedPins[3].pin.$suggestSolution = "j19_expansion.6";
GPIO3.associatedPins[4].pin.$suggestSolution = "j19_expansion.7";
GPIO3.associatedPins[5].pin.$suggestSolution = "j19_expansion.8";
PWM1.peripheral.$suggestSolution             = "TIMA0";
